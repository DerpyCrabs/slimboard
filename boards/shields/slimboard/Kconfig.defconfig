## boards/shields/slimboard/Kconfig.defconfig
```kconfig
if SHIELD_SLIMBOARD_LEFT

# Name must be less than 16 characters long!
config ZMK_KEYBOARD_NAME
    default "Slimboard"

config ZMK_SPLIT_ROLE_CENTRAL
    default y

endif

if SHIELD_SLIMBOARD_LEFT || SHIELD_SLIMBOARD_RIGHT

config ZMK_SPLIT
    default y

# Win+arrow: separate key release from modifier release (avoids stuck Win / Start menu).
config ZMK_HID_SEPARATE_MOD_RELEASE_REPORT
    default y

endif

if SHIELD_SLIMBOARD_DONGLE

config ZMK_KEYBOARD_NAME
    default "Slimboard"

config ZMK_SPLIT_ROLE_CENTRAL
    default y

config ZMK_SPLIT
    default y

config ZMK_HID_SEPARATE_MOD_RELEASE_REPORT
    default y

config ZMK_SPLIT_BLE_CENTRAL_PERIPHERALS
    default 2

config BT_MAX_CONN
    default 2

config BT_MAX_PAIRED
    default 2

endif
```

## boards/shields/slimboard/Kconfig.shield
```kconfig
config SHIELD_SLIMBOARD_LEFT
    def_bool $(shields_list_contains,slimboard_left)

config SHIELD_SLIMBOARD_RIGHT
    def_bool $(shields_list_contains,slimboard_right)

config SHIELD_SLIMBOARD_DONGLE
    def_bool $(shields_list_contains,slimboard_dongle)
```
